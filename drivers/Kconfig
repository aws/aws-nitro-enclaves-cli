## drivers/Kconfig
```kconfig
# SPDX-License-Identifier: GPL-2.0
#
# Copyright 2019 Amazon.com, Inc. or its affiliates. All Rights Reserved.
#
# This program is free software; you can redistribute it and/or modify it
# under the terms and conditions of the GNU General Public License,
# version 2, as published by the Free Software Foundation.
#
# This program is distributed in the hope that it will be useful,
# but WITHOUT ANY WARRANTY; without even the implied warranty of
# MERCHANTABILITY or FITNESS FOR A PARTICULAR PURPOSE. See the
# GNU General Public License for more details.
#
# You should have received a copy of the GNU General Public License
# along with this program; if not, see <http://www.gnu.org/licenses/>.

# Amazon Nitro CLI resource allocation configuration


config NITRO_CLI_RESOURCE_ALLOCATOR
	tristate "Nitro CLI resource allocation support"
	---help---
	  This driver supports memory allocation / free and
          cpu mapping / unmapping for Nitro CLI.

	  To compile this driver as a module, choose M here.
	  The module will be called nitro_cli_resource_allocator.
```

## drivers/virt/amazon/Kconfig
```kconfig
# SPDX-License-Identifier: GPL-2.0
#
# Copyright 2020 Amazon.com, Inc. or its affiliates. All Rights Reserved.
#
# This program is free software; you can redistribute it and/or modify it
# under the terms and conditions of the GNU General Public License,
# version 2, as published by the Free Software Foundation.
#
# This program is distributed in the hope that it will be useful,
# but WITHOUT ANY WARRANTY; without even the implied warranty of
# MERCHANTABILITY or FITNESS FOR A PARTICULAR PURPOSE. See the
# GNU General Public License for more details.
#
# You should have received a copy of the GNU General Public License
# along with this program; if not, see <http://www.gnu.org/licenses/>.

# Amazon Nitro Enclaves (NE) support.
# Nitro is a hypervisor, based on KVM, that has been developed by Amazon.

config NITRO_ENCLAVES
	tristate "Nitro Enclaves Support"
	---help---
	  This driver consists of support for enclave lifetime management
	  for Nitro Enclaves (NE).

	  To compile this driver as a module, choose M here.
	  The module will be called nitro_enclaves.
```
